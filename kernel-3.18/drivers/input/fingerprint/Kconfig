## kernel-3.18/drivers/input/fingerprint/Kconfig
```kconfig
#
#Fingerprint
#
menu "Fingerprint support"
	depends on INPUT

config MTK_FINGERPRINT_SUPPORT
	bool "Mediatek Fingerprint"
	default n
	---help---
	Fingerprint mtk driver enable/disable in the kernel.
	Say Y here if you want to use mediatek fingerprint driver,
	fingerprint driver will support fingerprint function

if MTK_FINGERPRINT_SUPPORT
config MTK_FINGERPRINT_SELECT
	string "sensor type"
#[Kent][FPS][17042102][Begin]add elan fps as default	
	#default "GF318M"
	default "ELAN"
#[Kent][FPS][17042102][End]add elan fps  as default

#[Kent][FPS][17042101][Begin]add elan fps driver
if MTK_FINGERPRINT_SELECT = "ELAN"
config ELAN_FINGERPRINT
	bool "ELAN Fingerprint"
	default y
endif
#[Kent][FPS][17042101][End]add elan fps driver
#[Kent][FPS][17071101][Begin]add egis fps driver
config EGIS_FINGERPRINT
	bool "EGIS Fingerprint"
	default y
#[Kent][FPS][17071101][end]add egis fps driver
if MTK_FINGERPRINT_SELECT = "FPC1145"
config FPC_FINGERPRINT
	bool "FPC Fingerprint"
	default y
	---help---
	FPC fingerprint FPC's 102x/104x device.
endif

if MTK_FINGERPRINT_SELECT = "GF318M"
config GOODIX_FINGERPRINT
	bool "Goodix Fingerprint"
	default y
	---help---
	Goodix Fingerprint chip GF316M/GF318M/GF3118M/GF518M/GF5118M/GF516M/GF816M/GF3208/GF5216 TEE driver

config GOODIX_SENSOR_TYPE
	string "SENSOR_TYPE"
	default "GF318M"
	---help---
	Must input sensor type, or default is GF316M GF318M GF3118M GF518M GF5118M GF516M GF816M GF3208 GF5216
endif
endif
endmenu
```
